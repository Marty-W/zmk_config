## config/west.yml
```yaml
manifest:
  remotes:
    - name: zmkfirmware
      url-base: https://github.com/ftc/
  projects:
    - name: zmk
      remote: zmkfirmware
      revision: mouse-ftc
      import: app/west.yml
  self:
    path: config

  # for errors check this guide: https://zmk.dev/docs/troubleshooting
```
